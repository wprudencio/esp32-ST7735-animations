#include <Adafruit_GFX.h>
#include <Adafruit_ST7735.h>
#include <SPI.h>
#include <Adafruit_NeoPixel.h>
#include <math.h>

#define TFT_CS    5
#define TFT_RST   4
#define TFT_DC    3
#define TFT_MOSI  2
#define TFT_SCLK  1

#define LED_PIN   10
#define NUMPIXELS 1

Adafruit_ST7735 tft = Adafruit_ST7735(TFT_CS, TFT_DC, TFT_RST);
Adafruit_NeoPixel pixels(NUMPIXELS, LED_PIN, NEO_GRB + NEO_KHZ800);

#define WIDTH  160
#define HEIGHT 128

// DVD logo bitmap — 1-bit per pixel, 64x28 = 1792 bits = 224 bytes
// Rendered from the actual DVD logo SVG (Wikipedia)
#define DVD_W 64
#define DVD_H 28
const uint8_t dvd_mask[224] PROGMEM = {
    0x07,0xFF,0xFF,0xFC,0x01,0xFF,0xFF,0xF0,0x07,0xFF,0xFF,0xFC,
    0x03,0xFF,0xFF,0xFC,0x0F,0xFF,0xFF,0xFC,0x07,0xFF,0xFF,0xFE,
    0x0F,0xFF,0xFF,0xFE,0x07,0xFF,0xFF,0xFE,0x0F,0xF3,0xFF,0xFE,
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    0x00,0xFF,0xFF,0xFF,0xFF,0xFF,0xF0,0x7E,
};

float lx, ly, lvx, lvy;

uint16_t colors[] = {0xF800,0x07E0,0x001F,0xFFE0,0x07FF,0xF81F,0xFD20,0xF7BE,0x5F1F};
#define NC 9
int ci = 0;

int px, py;  // previous position

// Blit the logo bitmap at (ox, oy) in the given color
void drawDVD(int ox, int oy, uint16_t col) {
  for (int y = 0; y < DVD_H; y++) {
    for (int x = 0; x < DVD_W; x++) {
      int bitIdx = y * DVD_W + x;
      uint8_t byteVal = pgm_read_byte(&dvd_mask[bitIdx / 8]);
      if (byteVal & (0x80 >> (bitIdx % 8))) {
        tft.drawPixel(ox + x, oy + y, col);
      }
    }
  }
}

void setup() {
  pixels.begin(); pixels.setBrightness(30); pixels.clear(); pixels.show();
  SPI.begin(TFT_SCLK, -1, TFT_MOSI, TFT_CS);
  tft.initR(INITR_BLACKTAB); tft.setRotation(1); tft.fillScreen(ST7735_BLACK);

  lx = (WIDTH - DVD_W) / 2;
  ly = (HEIGHT - DVD_H) / 2;
  lvx = random(2) ? 1.5 : -1.5;
  lvy = random(2) ? 1.1 : -1.1;

  px = lx; py = ly;
  drawDVD(lx, ly, colors[ci]);
}

void loop() {
  lx += lvx;
  ly += lvy;

  bool hit = false;
  if (lx < 0)              { lx = 0;              lvx = fabs(lvx); hit = true; }
  if (lx > WIDTH - DVD_W) { lx = WIDTH - DVD_W;  lvx = -fabs(lvx); hit = true; }
  if (ly < 0)              { ly = 0;              lvy = fabs(lvy); hit = true; }
  if (ly > HEIGHT - DVD_H){ ly = HEIGHT - DVD_H; lvy = -fabs(lvy); hit = true; }

  if (hit) ci = (ci + 1) % NC;

  int nx = lx, ny = ly;
  if (nx != px || ny != py) {
    // Erase old logo
    tft.fillRect(px - 1, py - 1, DVD_W + 2, DVD_H + 2, ST7735_BLACK);
    // White glow (draw logo in white 1px right and down)
    drawDVD(nx + 1, ny + 1, ST7735_WHITE);
    // Draw colored logo on top
    drawDVD(nx, ny, colors[ci]);
    px = nx; py = ny;
  }

  uint16_t bg = colors[ci];
  pixels.setPixelColor(0, pixels.Color((bg>>8)&0xF8, (bg>>3)&0xFC, (bg<<3)&0xF8));
  pixels.show();

  delay(18);
}
